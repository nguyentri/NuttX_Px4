## boards/arm/ra8/evk-ra8p1/Kconfig
```kconfig
# ##############################################################################
# boards/arm/rzv/evk-ra8p1/Kconfig
#
# Kconfig for the EVK-RA8P1 board support package for the RA8P1 MPU.
#
if ARCH_BOARD_EVK_RA8P1

config BOARD_EVK_RA8P1
    bool "EVK-RA8P1 Board Support"
    help
      Enable support for the EVK-RA8P1 board based on the RA8P1 MPU.

endif

config RA8P1_EXAMPLE_SUPPORT
    bool "EVK-RA8P1 Example Support"
    default y
    depends on BOARD_EVK_RA8P1
    help
      Enable support for various application examples for the EVK-RA8P1 board.
      Disable when building with PX4 firmware.

config RA8P1_SPI_LOOPBACK_EXAMPLE
	bool "SPI loopback test example"
	default n
	depends on RA_SPI && RA8P1_EXAMPLE_SUPPORT
	---help---
		Enable SPI internal loopback test example for verifying
		SPI driver functionality on EVK-RA8P1 board.

config RA8P1_OSPI_EXAMPLE
	bool "OSPI test example"
	default n
	depends on RA_OSPI && RA8P1_EXAMPLE_SUPPORT
	---help---
		Enable OSPI test example for verifying OSPI driver functionality
		on EVK-RA8P1 board.

config RA8P1_USB_CDC_CONSOLE
	bool "USB CDC/ACM console"
	default n
	depends on RA_USBDEV && CDCACM
	select USBDEV_TRACE
	---help---
		Enable USB CDC/ACM virtual serial port as system console.
		This allows nsh shell and other console output over USB.

config RA8P1_SCI_SPI_EXAMPLE
	bool "SCI SPI test example"
	default n
	depends on RA_SCI_SPI && RA8P1_EXAMPLE_SUPPORT
	---help---
		Enable SCI SPI test example for verifying SCI SPI driver functionality
		on EVK-RA8P1 board.

config RA8P1_ADC_HW_TRIGGER_EXAMPLE
	bool "ELC GPT-triggered ADC example"
	default n
	depends on RA_ELC && RA_GPT && RA_ADC && RA8P1_EXAMPLE_SUPPORT
	---help---
		Enable ELC example that demonstrates GPT timer triggering ADC
		conversions without CPU intervention. This configures:
		- GPT0 counter overflow -> ADC0 scan trigger
		- Software event 0 -> GPT A start trigger
		- GPT0 overflow -> GPT B stop trigger

config RA8P1_I3C_EXAMPLE
	bool "I3C example"
	default n
	depends on RA_I3C && RA8P1_EXAMPLE_SUPPORT
	---help---
		Enable I3C test example for verifying I3C driver functionality
		on EVK-RA8P1 board.

config RA8P1_WDT_TEST
	bool "WDT example "
	default n
	depends on RA_WDT && WATCHDOG && RA8P1_EXAMPLE_SUPPORT
	---help---
		Enable WDT test application that demonstrates watchdog timer
		functionality similar to FSP reference example. The application:
		- Initializes WDT with 2-second timeout
		- Refreshes WDT every 1 second via periodic timer
		- Prints refresh status every 3 seconds
		- Pressing SW1 button stops refresh, triggering WDT reset
		- LED indicates reset status and activity

config RA8P1_IPC_TEST
	bool "IPC dual-core communication test"
	default n
	depends on RA_IPC && RA8P1_EXAMPLE_SUPPORT
	---help---
		Enable IPC test application for dual-core communication testing.
		This application demonstrates:
		- Hardware semaphore operations
		- Channel-based message passing
		- Interrupt-driven communication
		- IPC mutex synchronization

		Build and flash this application on BOTH cores (CM85 and CM33)
		to test inter-processor communication.
```

## boards/arm/rzv/evk-rzv2h/Kconfig
```kconfig
# ##############################################################################
# boards/arm/rzv/evk-rzv2h/Kconfig
#
# Kconfig for the EVK-RZV2H board support package for the RZV2H MPU.
#
if ARCH_BOARD_EVK_RZV2H

config BOARD_EVK_RZV2H
    bool "EVK-RZV2H Board Support"
    help
      Enable support for the EVK-RZV2H board based on the RZV2H MPU.

config BOARD_EVK_RZV2H_I2C_GY912_EXAMPLE
    bool "Enable GY-912 I2C sensor example"
    default n
    depends on RZV_RIIC
    help
      Enable the GY-912 sensor module example application. This example
      demonstrates I2C communication with the ICM-20948 9-axis IMU and
      BMP388 pressure sensor on the GY-912 module using the RIIC interface.

endif

# ##############################################################################
```

## boards/arm/rzv/rdk-rzv2h/Kconfig
```kconfig
# ##############################################################################
# boards/arm/rzv/rdk-rzv2h/Kconfig
#
# Kconfig for the RDK-RZV2H board support package for the RZV2H MPU.
#
if ARCH_BOARD_RDK_RZV2H

config BOARD_RDK_RZV2H
    bool "RDK-RZV2H Board Support"
    help
      Enable support for the RDK-RZV2H board based on the RZV2H MPU.

endif

config RZV2H_EXAMPLE_SUPPORT
    bool "RDK-RZV2H Example Support"
    default y
    depends on ARCH_BOARD_RDK_RZV2H
    help
      Enable support for various application examples for the RDK-RZV2H board.
      Disable when building with PX4 firmware.

config RZV2H_SPI_LOOPBACK_EXAMPLE
    bool "SPI loopback test example"
    default n
    depends on RZV_SPI && RZV2H_EXAMPLE_SUPPORT
    ---help---
      Enable SPI internal loopback test example for verifying
      SPI driver functionality on RDK-RZV2H board.

config RZV2H_PWM_ONESHOT_EXAMPLE
    bool "GPT PWM oneshot mode example"
    default n
    depends on RZV_PWM && RZV2H_EXAMPLE_SUPPORT
    ---help---
      Enable GPT PWM oneshot mode example for verifying oneshot
      functionality on RDK-RZV2H board.

config RDK_RZV2H_XSPI_PARAMFS
    bool "RDK-RZV2H XSPI LittleFS parameter storage"
    default n
    depends on ARCH_BOARD_RDK_RZV2H && FS_LITTLEFS
    select MTD
    ---help---
      Enable the CR8-owned XSPI parameter MTD and mount it as LittleFS at
      /fs. PX4 stores parameters at /fs/params when this option is enabled.

config RZV2H_ADC_EXAMPLE
    bool "ADC test example"
    default n
    depends on RZV_ADC && RZV2H_EXAMPLE_SUPPORT
    ---help---
      Enable ADC test example for verifying ADC driver functionality
      on RDK-RZV2H board.

config RZV2H_WDT_TEST
    bool "Watchdog Timer (WDT) test application"
    default n
    depends on RZV_WDT && RZV2H_EXAMPLE_SUPPORT
    ---help---
      Enable WDT test application for verifying watchdog timer functionality
      on RDK-RZV2H board. This application demonstrates watchdog initialization,
      periodic refresh, timeout testing, and system reset behavior.

# ##############################################################################
```

## boards/arm/rzv/rdk-rzv2h/configs/canfd/defconfig
```kconfig
#
# RDK-RZV2H CAN-FD configuration.
#
# Based on nsh/defconfig with CAN-FD driver enabled on CH0 (/dev/can0).
# Boot mode: internal loopback (driver default — no defconfig knob needed).
# Use "make menuconfig" to make any modifications; "make savedefconfig"
# to regenerate.
#
CONFIG_ARCH="arm"
CONFIG_ARCH_BOARD="rdk-rzv2h"
CONFIG_ARCH_BOARD_RDK_RZV2H=y
CONFIG_ARCH_CHIP="rzv"
CONFIG_ARCH_CHIP_RZV=y
CONFIG_ARCH_CHIP_R9A09G057=y
CONFIG_ARMV7R_TOOLCHAIN_GNU_EABI=y
CONFIG_ARCH_STACKDUMP=y
CONFIG_ARMV7R_DCACHE=y
CONFIG_ARMV7R_DTCM=y
CONFIG_ARMV7R_ICACHE=y
CONFIG_ARMV7R_ITCM=y
CONFIG_BINFMT_DISABLE=y
CONFIG_BOARD_LOOPSPERMSEC=200000
CONFIG_BUILTIN=y
CONFIG_FS_PROCFS=y
CONFIG_IDLETHREAD_STACKSIZE=2048
CONFIG_INIT_ENTRYPOINT="nsh_main"
CONFIG_INTELHEX_BINARY=y
CONFIG_LIBC_LOCALTIME=y
CONFIG_LINE_MAX=64
CONFIG_NSH_ARCHINIT=y
CONFIG_NSH_BUILTIN_APPS=y
CONFIG_NSH_DISABLE_IFUPDOWN=y
CONFIG_NSH_FILEIOSIZE=512
CONFIG_NSH_READLINE=y
CONFIG_RZV_DTCM=16
CONFIG_RZV_ITCM=16
CONFIG_RAM_SIZE=524288
CONFIG_RAM_START=0x22060000
CONFIG_RAW_BINARY=y
CONFIG_SCHED_BACKTRACE=y
CONFIG_START_DAY=10
CONFIG_START_MONTH=9
CONFIG_START_YEAR=2025
CONFIG_SYSTEM_NSH=y
CONFIG_SYSTEM_NSH_PRIORITY=100
CONFIG_SYSTEM_NSH_STACKSIZE=2048
CONFIG_USEC_PER_TICK=1000
CONFIG_SPINLOCK=y

# NSH Library
CONFIG_NSH_LIBRARY=y
CONFIG_NSH_CONSOLE=y
CONFIG_NSH_UARTDEV="/dev/ttyS0"
CONFIG_NSH_CONDEV="/dev/ttyS0"

# Core Specific Configuration
CONFIG_RZV2H_BUILD_CR8_0=y

# Clocking Configuration
CONFIG_RZV_CLOCK_PLL=y

# Serial Configuration (SCI1 for NSH console)
CONFIG_SERIAL=y
CONFIG_STANDARD_SERIAL=y
CONFIG_SCI1_SERIALDRIVER=y
CONFIG_SCI1_SERIAL_CONSOLE=y
CONFIG_SCI1_RXBUFSIZE=256
CONFIG_SCI1_TXBUFSIZE=256
CONFIG_SCI1_BAUD=115200
CONFIG_SCI1_BITS=8
CONFIG_SCI1_PARITY=0
CONFIG_SCI1_2STOP=0
CONFIG_RZV_SCI1=y

# Console support
CONFIG_DEV_CONSOLE=y
CONFIG_SERIAL_CONSOLE=y

# Debug features
CONFIG_DEBUG_ALERT=y
CONFIG_DEBUG_ERROR=y
CONFIG_DEBUG_WARN=y
CONFIG_DEBUG_INFO=y
CONFIG_DEBUG_FEATURES=y
CONFIG_DEBUG_FULLOPT=y
CONFIG_DEBUG_SYMBOLS=y
CONFIG_DEBUG_SYMBOLS_LEVEL="-g3"
CONFIG_DEBUG_OPTLEVEL="-O0"

# FPU Configuration
CONFIG_ARCH_FPU=y
CONFIG_ARCH_DPFPU=y

# CAN-FD driver (RZ/V2H CANFD IP, CH0 only at v1)
CONFIG_CAN=y
CONFIG_CAN_FD=y
CONFIG_CAN_NPOLLWAITERS=4
CONFIG_RZV_CANFD=y
CONFIG_RZV_CANFD0=y

# CAN example application (apps/examples/can)
CONFIG_EXAMPLES_CAN=y
```

## boards/arm/rzv/rdk-rzv2h/configs/gtm/defconfig
```kconfig
#
# Configuration for GTM Timer Testing on RDK-RZV2H
# Based on NSH configuration with timer driver support added
#
CONFIG_ARCH="arm"
CONFIG_ARCH_BOARD="rdk-rzv2h"
CONFIG_ARCH_BOARD_RDK_RZV2H=y
CONFIG_ARCH_CHIP="rzv"
CONFIG_ARCH_CHIP_RZV=y
CONFIG_ARCH_CHIP_R9A09G057=y
CONFIG_ARMV7R_TOOLCHAIN_GNU_EABI=y
CONFIG_ARCH_STACKDUMP=y
CONFIG_ARMV7R_DCACHE=y
CONFIG_ARMV7R_DTCM=y
CONFIG_ARMV7R_ICACHE=y
CONFIG_ARMV7R_ITCM=y
CONFIG_BINFMT_DISABLE=y
CONFIG_BOARD_LOOPSPERMSEC=200000
CONFIG_BUILTIN=y
CONFIG_FS_PROCFS=y
CONFIG_IDLETHREAD_STACKSIZE=2048
CONFIG_INIT_ENTRYPOINT="nsh_main"
CONFIG_INTELHEX_BINARY=y
CONFIG_LIBC_LOCALTIME=y
CONFIG_LINE_MAX=64
CONFIG_NSH_ARCHINIT=y
CONFIG_NSH_BUILTIN_APPS=y
CONFIG_NSH_DISABLE_IFUPDOWN=y
CONFIG_NSH_FILEIOSIZE=512
CONFIG_NSH_READLINE=y
CONFIG_RZV_DTCM=16
CONFIG_RZV_ITCM=16
CONFIG_RAM_SIZE=524288
CONFIG_RAM_START=0x22060000
CONFIG_RAW_BINARY=y
CONFIG_SCHED_BACKTRACE=y
CONFIG_START_DAY=19
CONFIG_START_MONTH=12
CONFIG_START_YEAR=2025
CONFIG_SYSTEM_NSH=y
CONFIG_SYSTEM_NSH_PRIORITY=100
CONFIG_SYSTEM_NSH_STACKSIZE=2048
CONFIG_USEC_PER_TICK=1000
CONFIG_SPINLOCK=y

# NSH Library - Use SCI1 for command interface
CONFIG_NSH_LIBRARY=y
CONFIG_NSH_CONSOLE=y
CONFIG_NSH_UARTDEV="/dev/ttyS0"
CONFIG_NSH_CONDEV="/dev/ttyS0"

# Core Specific Configuration
CONFIG_RZV2H_BUILD_CR8_0=y

# Clocking Configuration
CONFIG_RZV_CLOCK_PLL=y

# Serial Configuration (SCI1 for NSH console)
CONFIG_SERIAL=y
CONFIG_STANDARD_SERIAL=y
CONFIG_SCI1_SERIALDRIVER=y
CONFIG_SCI1_SERIAL_CONSOLE=y
CONFIG_SCI1_RXBUFSIZE=256
CONFIG_SCI1_TXBUFSIZE=256
CONFIG_SCI1_BAUD=115200
CONFIG_SCI1_BITS=8
CONFIG_SCI1_PARITY=0
CONFIG_SCI1_2STOP=0
CONFIG_RZV_SCI1=y

# Console support (SCI1 will be console)
CONFIG_DEV_CONSOLE=y
CONFIG_SERIAL_CONSOLE=y

# Debug features
CONFIG_DEBUG_ALERT=y
CONFIG_DEBUG_ERROR=y
CONFIG_DEBUG_WARN=y
CONFIG_DEBUG_INFO=y
CONFIG_DEBUG_FEATURES=y
CONFIG_DEBUG_FULLOPT=y
CONFIG_DEBUG_SYMBOLS=y
CONFIG_DEBUG_SYMBOLS_LEVEL="-g3"
CONFIG_DEBUG_OPTLEVEL="-O0"

# Timer debugging
CONFIG_DEBUG_TIMER=y
CONFIG_DEBUG_TIMER_ERROR=y
CONFIG_DEBUG_TIMER_WARN=y
CONFIG_DEBUG_TIMER_INFO=y

# FPU Configuration
CONFIG_ARCH_FPU=y
CONFIG_ARCH_DPFPU=y

# Timer Driver Support
CONFIG_TIMER=y
CONFIG_TIMER_ARCH=y

# RZV GTM Timer Configuration
CONFIG_RZV_GTM=y
CONFIG_RZV_GTM0_TIMER=y
CONFIG_RZV_GTM2_TIMER=y

# Timer test application
CONFIG_EXAMPLES_TIMER=y
CONFIG_EXAMPLES_TIMER_DEVNAME="/dev/timer0"
CONFIG_EXAMPLES_TIMER_INTERVAL=1000000
CONFIG_EXAMPLES_TIMER_DELAY=100000
CONFIG_EXAMPLES_TIMER_NSAMPLES=20
CONFIG_EXAMPLES_TIMER_SIGNO=17
CONFIG_EXAMPLES_TIMER_STACKSIZE=2048
CONFIG_EXAMPLES_TIMER_PRIORITY=100
```

## boards/arm/rzv/rdk-rzv2h/configs/hil-full/defconfig
```kconfig
#
# HWTEST HIL full — real PX4 drone sensors per RDK-RZ/V2H pinout.
# MPU9250 (SPI Pin19/21/23/24), BMP280 (I2C7 Pin3/5), GPS-M10 (UART9),
# TFmini (UART4), Sik (UART5 optional).
#
CONFIG_ARCH="arm"
CONFIG_ARCH_BOARD="rdk-rzv2h"
CONFIG_ARCH_BOARD_RDK_RZV2H=y
CONFIG_ARCH_CHIP="rzv"
CONFIG_ARCH_CHIP_RZV=y
CONFIG_ARCH_CHIP_R9A09G057=y
CONFIG_ARMV7R_TOOLCHAIN_GNU_EABI=y
CONFIG_ARCH_STACKDUMP=y
CONFIG_ARMV7R_DCACHE=y
CONFIG_ARMV7R_DTCM=y
CONFIG_ARMV7R_ICACHE=y
CONFIG_ARMV7R_ITCM=y
CONFIG_BINFMT_DISABLE=y
CONFIG_BOARD_LOOPSPERMSEC=200000
CONFIG_BUILTIN=y
CONFIG_FS_PROCFS=n
CONFIG_IDLETHREAD_STACKSIZE=2048
CONFIG_INIT_ENTRYPOINT="hwtest_main"
CONFIG_INTELHEX_BINARY=y
CONFIG_LIBC_LOCALTIME=y
CONFIG_LINE_MAX=128
CONFIG_RZV_DTCM=16
CONFIG_RZV_ITCM=16
CONFIG_RAM_SIZE=524288
CONFIG_RAM_START=0x22060000
CONFIG_RAW_BINARY=y
CONFIG_SCHED_BACKTRACE=y
CONFIG_START_DAY=16
CONFIG_START_MONTH=5
CONFIG_START_YEAR=2026
CONFIG_USEC_PER_TICK=1000
CONFIG_SPINLOCK=y

# Clock
CONFIG_RZV_CLOCK_PLL=y

# RTT-only console
CONFIG_DEV_CONSOLE=y
# CONFIG_SERIAL_CONSOLE is not set
CONFIG_SERIAL_RTT0=y
CONFIG_SERIAL_RTT_CONSOLE=y
CONFIG_SYSLOG_RTT=y
CONFIG_SEGGER_RTT=y
CONFIG_SEGGER_RTT_BUFFER_SIZE_UP=4096
CONFIG_SEGGER_RTT_BUFFER_SIZE_DOWN=1024
CONFIG_SEGGER_RTT_PRINTF_BUFFER_SIZE=1024

# SPI for MPU9250
CONFIG_SPI=y
CONFIG_SPI_DRIVER=y
CONFIG_SPI_EXCHANGE=y
CONFIG_SPI_CMDDATA=y
CONFIG_RZV_SPI=y
CONFIG_RZV_SPI0=y

# I2C7 (SCI-I2C on P76/P77) for BMP280
CONFIG_I2C=y
CONFIG_I2C_DRIVER=y
CONFIG_RZV_SCI_I2C=y
CONFIG_RZV_SCI_I2C7=y

# UART4 (TFmini), UART5 (Sik), UART9 (GPS)
CONFIG_SERIAL=y
CONFIG_STANDARD_SERIAL=y
CONFIG_SERIAL_TERMIOS=y

CONFIG_RZV_SCI4=y
CONFIG_SCI4_SERIALDRIVER=y
CONFIG_SCI4_BAUD=115200
CONFIG_SCI4_BITS=8
CONFIG_SCI4_PARITY=0
CONFIG_SCI4_2STOP=0
CONFIG_SCI4_RXBUFSIZE=512
CONFIG_SCI4_TXBUFSIZE=512

CONFIG_RZV_SCI5=y
CONFIG_SCI5_SERIALDRIVER=y
CONFIG_SCI5_BAUD=57600
CONFIG_SCI5_BITS=8
CONFIG_SCI5_PARITY=0
CONFIG_SCI5_2STOP=0
CONFIG_SCI5_RXBUFSIZE=512
CONFIG_SCI5_TXBUFSIZE=512

CONFIG_RZV_SCI9=y
CONFIG_SCI9_SERIALDRIVER=y
CONFIG_SCI9_BAUD=9600
CONFIG_SCI9_BITS=8
CONFIG_SCI9_PARITY=0
CONFIG_SCI9_2STOP=0
CONFIG_SCI9_RXBUFSIZE=512
CONFIG_SCI9_TXBUFSIZE=512

# Debug
CONFIG_DEBUG_ALERT=y
CONFIG_DEBUG_ERROR=y
CONFIG_DEBUG_FEATURES=y
CONFIG_DEBUG_FULLOPT=y
CONFIG_DEBUG_SYMBOLS=y
CONFIG_DEBUG_SYMBOLS_LEVEL="-g3"
CONFIG_DEBUG_OPTLEVEL="-O0"

# HWTEST app
CONFIG_TESTING_RZV_HWTEST=y
CONFIG_TESTING_RZV_HWTEST_MODE_HIL_FULL=y
CONFIG_TESTING_RZV_HWTEST_PROGNAME="hwtest"
CONFIG_TESTING_RZV_HWTEST_PRIORITY=100
CONFIG_TESTING_RZV_HWTEST_STACKSIZE=8192
```

## boards/arm/rzv/rdk-rzv2h/configs/hil-spi-loopback/defconfig
```kconfig
#
# HWTEST SPI loopback — MOSI<->MISO (Pin 19<->21). MPU9250 removed.
#
CONFIG_ARCH="arm"
CONFIG_ARCH_BOARD="rdk-rzv2h"
CONFIG_ARCH_BOARD_RDK_RZV2H=y
CONFIG_ARCH_CHIP="rzv"
CONFIG_ARCH_CHIP_RZV=y
CONFIG_ARCH_CHIP_R9A09G057=y
CONFIG_ARMV7R_TOOLCHAIN_GNU_EABI=y
CONFIG_ARCH_STACKDUMP=y
CONFIG_ARMV7R_DCACHE=y
CONFIG_ARMV7R_DTCM=y
CONFIG_ARMV7R_ICACHE=y
CONFIG_ARMV7R_ITCM=y
CONFIG_BINFMT_DISABLE=y
CONFIG_BOARD_LOOPSPERMSEC=200000
CONFIG_BUILTIN=y
CONFIG_FS_PROCFS=n
CONFIG_IDLETHREAD_STACKSIZE=2048
CONFIG_INIT_ENTRYPOINT="hwtest_main"
CONFIG_INTELHEX_BINARY=y
CONFIG_LIBC_LOCALTIME=y
CONFIG_LINE_MAX=128
CONFIG_RZV_DTCM=16
CONFIG_RZV_ITCM=16
CONFIG_RAM_SIZE=524288
CONFIG_RAM_START=0x22060000
CONFIG_RAW_BINARY=y
CONFIG_SCHED_BACKTRACE=y
CONFIG_START_DAY=16
CONFIG_START_MONTH=5
CONFIG_START_YEAR=2026
CONFIG_USEC_PER_TICK=1000
CONFIG_SPINLOCK=y

# Clock
CONFIG_RZV_CLOCK_PLL=y

# RTT-only console
CONFIG_DEV_CONSOLE=y
# CONFIG_SERIAL_CONSOLE is not set
CONFIG_SERIAL_RTT0=y
CONFIG_SERIAL_RTT_CONSOLE=y
CONFIG_SYSLOG_RTT=y
CONFIG_SEGGER_RTT=y
CONFIG_SEGGER_RTT_BUFFER_SIZE_UP=4096
CONFIG_SEGGER_RTT_BUFFER_SIZE_DOWN=1024
CONFIG_SEGGER_RTT_PRINTF_BUFFER_SIZE=1024

# SPI
CONFIG_SPI=y
CONFIG_SPI_DRIVER=y
CONFIG_SPI_EXCHANGE=y
CONFIG_SPI_CMDDATA=y
CONFIG_RZV_SPI=y
CONFIG_RZV_SPI0=y

# Debug
CONFIG_DEBUG_ALERT=y
CONFIG_DEBUG_ERROR=y
CONFIG_DEBUG_FEATURES=y
CONFIG_DEBUG_FULLOPT=y
CONFIG_DEBUG_SYMBOLS=y
CONFIG_DEBUG_SYMBOLS_LEVEL="-g3"
CONFIG_DEBUG_OPTLEVEL="-O0"

# HWTEST app
CONFIG_TESTING_RZV_HWTEST=y
CONFIG_TESTING_RZV_HWTEST_MODE_SPI_LOOPBACK=y
CONFIG_TESTING_RZV_HWTEST_PROGNAME="hwtest"
CONFIG_TESTING_RZV_HWTEST_PRIORITY=100
CONFIG_TESTING_RZV_HWTEST_STACKSIZE=8192
```
